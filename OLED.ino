
//WARNING: This Font Require X-GLCD Lib.
//         You can not use it with MikroE GLCD Lib.

//Font Generated by MikroElektronika GLCD Font Creator 1.2.0.0
//MikroElektronika 2011
//http://www.mikroe.com

//GLCD FontName : Consolas26x40
//GLCD FontSize : 26 x 40 (actual is 20 x 32)
// 80 bytes per char 20 x 4... vertically scanning bytes 4 at a time

const uint8_t fontConsole[] PROGMEM =  {
  0x13, 0x00, 0x00, 0x00, 0x00, 0x00, 0x00, 0x00, 0x00, 0x00, 0xF0, 0x3F,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 0x00,  // Code for char 0
  0x12, 0x00, 0x00, 0x00, 0x00, 0x00, 0x00, 0x00, 0x00, 0x00, 0x02, 0x00,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 0x00,  // Code for char 1
  0x13, 0x00, 0x00, 0x00, 0x00, 0x00, 0x00, 0x00, 0x00, 0x00, 0x00, 0x00,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 0x00,  // Code for char 2
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  0x13, 0x00, 0x00, 0x00, 0x00, 0x98, 0xF8, 0xFF, 0x1F, 0x24, 0xFD, 0xFF,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 0x00, 0x00   // Code for char b (SD ICON)
};




const uint8_t font5x7[] PROGMEM = { // space is at the bottom (=2 spaces with double height letters)
  // this is 475, enuff for eeprom =>548

  0x00, 0x00, 0x00, 0x00, 0x00, // (space)    by GLCD FONT CREATOR
  0x00, 0x00, 0x5F, 0x00, 0x00, // !
  0x00, 0x07, 0x00, 0x07, 0x00, // "
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  0x14, 0x3E, 0x55, 0x41, 0x22, // â‚¬

  // 0x08, 0x08, 0x2A, 0x1C, 0x08, // -> (ALT + 0134) â€ 
  // 0x08, 0x1C, 0x2A, 0x08, 0x08, // <- (ALT + 0135) â€¡
  // 0x00, 0x00, 0x07, 0x05, 0x07  // Â°

};








#define BLACK                          0 ///< Draw 'off' pixels
#define WHITE                          1 ///< Draw 'on' pixels
#define INVERSE                        2 ///< Invert pixels

#define SSD1306_MEMORYMODE          0x20 ///< See datasheet
#define SSD1306_COLUMNADDR          0x21 ///< See datasheet
#define SSD1306_PAGEADDR            0x22 ///< See datasheet
#define SSD1306_SETCONTRAST         0x81 ///< See datasheet
#define SSD1306_CHARGEPUMP          0x8D ///< See datasheet
#define SSD1306_SEGREMAP            0xA0 ///< See datasheet
#define SSD1306_DISPLAYALLON_RESUME 0xA4 ///< See datasheet
#define SSD1306_DISPLAYALLON        0xA5 ///< Not currently used
#define SSD1306_NORMALDISPLAY       0xA6 ///< See datasheet
#define SSD1306_INVERTDISPLAY       0xA7 ///< See datasheet
#define SSD1306_SETMULTIPLEX        0xA8 ///< See datasheet
#define SSD1306_DISPLAYOFF          0xAE ///< See datasheet
#define SSD1306_DISPLAYON           0xAF ///< See datasheet
#define SSD1306_COMSCANINC          0xC0 ///< Not currently used
#define SSD1306_COMSCANDEC          0xC8 ///< See datasheet
#define SSD1306_SETDISPLAYOFFSET    0xD3 ///< See datasheet
#define SSD1306_SETDISPLAYCLOCKDIV  0xD5 ///< See datasheet
#define SSD1306_SETPRECHARGE        0xD9 ///< See datasheet
#define SSD1306_SETCOMPINS          0xDA ///< See datasheet
#define SSD1306_SETVCOMDETECT       0xDB ///< See datasheet

#define SSD1306_SETLOWCOLUMN        0x00 ///< Not currently used
#define SSD1306_SETHIGHCOLUMN       0x10 ///< Not currently used
#define SSD1306_SETSTARTLINE        0x40 ///< See datasheet

#define SSD1306_EXTERNALVCC         0x01 ///< External display voltage source
#define SSD1306_SWITCHCAPVCC        0x02 ///< Gen. display voltage from 3.3V

#define SSD1306_RIGHT_HORIZONTAL_SCROLL              0x26 ///< Init rt scroll
#define SSD1306_LEFT_HORIZONTAL_SCROLL               0x27 ///< Init left scroll
#define SSD1306_VERTICAL_AND_RIGHT_HORIZONTAL_SCROLL 0x29 ///< Init diag scroll
#define SSD1306_VERTICAL_AND_LEFT_HORIZONTAL_SCROLL  0x2A ///< Init diag scroll
#define SSD1306_DEACTIVATE_SCROLL                    0x2E ///< Stop scroll
#define SSD1306_ACTIVATE_SCROLL                      0x2F ///< Start scroll
#define SSD1306_SET_VERTICAL_SCROLL_AREA             0xA3 ///< Set scroll range

#define HEIGHT  0x20
#define WIDTH   0x80

//#define HEIGHT  64
//#define WIDTH   128
void oled() {
  // Init sequence
  static const uint8_t PROGMEM init1[] = {
    SSD1306_DISPLAYOFF,                   // 0xAE
    SSD1306_SETDISPLAYCLOCKDIV,           // 0xD5
    0xA0,//0xA0, // 0x80,                                 // the suggested ratio 0x80... mainly to control scroll speed
    SSD1306_SETMULTIPLEX,
    0x3f
  };               // 0xA8

  ssd1306_commandList(init1, sizeof(init1));
  ssd1306_command1(HEIGHT - 1);

  static const uint8_t PROGMEM init2[] = {
    SSD1306_SETDISPLAYOFFSET,             // 0xD3
    0x00,                                  // no offset
    SSD1306_SETSTARTLINE | 0x0,           // line #0
    SSD1306_CHARGEPUMP,
    0x14,
    0xAF
  };                                                            // 0x8D

  ssd1306_commandList(init2, sizeof(init2));

  //ssd1306_command1((vccstate == SSD1306_EXTERNALVCC) ? 0x10 : 0x14);
  //ssd1306_command1(0x14);

  static const uint8_t PROGMEM init3[] = {
    SSD1306_MEMORYMODE,                   // 0x20
    0x01,                                                           // 0x0 act like ks0108
    SSD1306_SEGREMAP | 0x1,
    SSD1306_COMSCANDEC
  };

  ssd1306_commandList(init3, sizeof(init3));

  // if ((WIDTH == 128) && (HEIGHT == 64)) {
  static const uint8_t PROGMEM init4b[] = {
    SSD1306_SETCOMPINS,                 // 0xDA
    0x02, //0x12,
    SSD1306_SETCONTRAST,
    0x8f, // 0xFF,
    SSD1306_SETPRECHARGE, //F1 is brightest
    0xF1,
    //   SSD1306_COLUMNADDR ,
    //    0x00, 0x7f,
    //    SSD1306_PAGEADDR,
    //    0x00, 0x07

  };              // 0x81
  ssd1306_commandList(init4b, sizeof(init4b));
  // ssd1306_command1((vccstate == SSD1306_EXTERNALVCC) ? 0x9F : 0xCF);
  //  }


  // ssd1306_command1(SSD1306_SETPRECHARGE); // 0xd9
  //ssd1306_command1((vccstate == SSD1306_EXTERNALVCC) ? 0x22 : 0xF1);
  static const uint8_t PROGMEM init5[] = {
    SSD1306_SETVCOMDETECT,               // 0xDB
    0x40, //was 40, works best! NOT EVEN IN DATASHEET!
    SSD1306_DISPLAYALLON_RESUME,         // 0xA4
    SSD1306_NORMALDISPLAY,               // 0xA6
    // SSD1306_ACTIVATE_SCROLL,  //
    SSD1306_DEACTIVATE_SCROLL,
    SSD1306_DISPLAYON
  };                 // Main screen turn on
  ssd1306_commandList(init5, sizeof(init5));


  static const uint8_t PROGMEM init6[] = {
    SSD1306_LEFT_HORIZONTAL_SCROLL,
    0x00,
    0x00,   //start page
    0x07,   //frames (see datasheet) can be used @ 25 with frequency controlling speed
    0x07,  //end page
    0x00,  //vertical scroll offset
    0xFF
  };
  ssd1306_commandList(init6, sizeof(init6));


}

//============================================================================================================


void ssd1306_command1(uint8_t c) { // Co = 0, D/C = 0
  Wire.beginTransmission(0x3C); Wire.write((uint8_t)0x00); Wire.write(c); WireendTransmission();
}



void ssd1306_commandList(const uint8_t *c, uint8_t n) {

  Wire.beginTransmission(0x3C);
  Wire.write((uint8_t)0x00); // Co = 0, D/C = 0
  bytesOut = 1;
  while (n--) {
    //  if (bytesOut >= 32) {
    wireReBuff(30);  // Wire.endTransmission(); Wire.beginTransmission(0x3C); Wire.write((uint8_t)0x00); bytesOut = 1; // Co = 0, D/C = 0
    //   }
    Wire.write(pgm_read_byte(c++));
    bytesOut++;
  }
  WireendTransmission();

}


void WireendTransmission() {
  Wire.endTransmission();
}
void wireReBuff(byte gt) {
  if (bytesOut >= gt) {
    WireendTransmission(); Wire.beginTransmission(0x3C); Wire.write(0B01000000); bytesOut = 1;
  }
}

void wireBegin() {
  Wire.beginTransmission(0x3C);//OLED slave address = 0 (or 3D)
  Wire.write(0B01000000); // D/C#  = data or command flag (in control byte)..i guess you just shove data in now (after setting start line?)
  bytesOut = 1;
}

void wireWrite(byte w) {
  Wire.write(w); bytesOut++;
}
void Wirewrite(byte w) {
  Wire.write(w); // this on doesn't inc bytes out!
}


void OLED_UD(int count, byte cs, byte ce, byte ps, byte pe) {     //update whole page...? no way, takes too much memory!..read chars from progmem arrays
  OLED_pointTo(cs, ce, ps,  pe); // put here as all UD's use it!
  wireBegin(); OLEDbusy = true;
  byte k = 0; byte s = 0;
  for (int i = 0; i < count; i++) {
    //   if (bytesOut >= 30) {
    wireReBuff(30);// if (count < 1024) loop(); //call loop if not in menus...change this to menu flag etc..
    //    }
    bytesOut++; k = 0;
    //    if (lowFid == 1 && (i & 0x01) == 0) { //erase for keyboard display. Make bar across top
    //      k = 1; if (s == 0) k = 3; //make notches every C note
    //      s++; if (s > 11) s = 0;
    //    }
    Wirewrite(k);
  }
  WireendTransmission(); OLEDbusy = false;  // stop transmitting
}




void OLED_pointTo(byte cs, byte ce, byte ps, byte pe) { //set column and page (0-127) (0-7) col start/end page start/end . col is left right, page up down
  Wire.beginTransmission(0x3C);//OLED slave address
  Wirewrite(0x00); Wirewrite(0x21); Wirewrite(cs); Wirewrite(ce);
  WireendTransmission();     // stop transmitting                                <<<<<<<<<<<<<<must be separate!!!!
  Wire.beginTransmission(0x3C);//OLED slave address
  Wirewrite(0x00); Wirewrite(0x22); Wirewrite(ps); Wirewrite(pe);
  WireendTransmission();     // stop transmitting
}






void OLEDwerds(String werd, byte col, byte page, byte L) { //BIG CHARS
  byte p = page & 0x07; int limit = col; //<<in this 128x32 OLED these chars use entire display!
  int w = 0;//for counting colums (/4 then sets curse var)
  byte Lsize = 4;
  OLED_pointTo(col, 127, p + 4, p + 7); //lower ram is displayed !!!
  wireBegin();
  if (L == 0) L = werd.length();
  for (byte i = 0; i < L; i++) {
    int let = (werd.charAt(i) - 48) * 81; Lsize = pgm_read_byte_near(fontConsole + let); Lsize *= 4; let += 1; // letter is 1+ (20 x 4)  and len is first so skip!
    if (let < 0) {
      if (werd.charAt(i) == 46) {
        let = 47 * 81; let += 1; Lsize = 28; //for period/decimal!!
      } else {
        if (werd.charAt(i) == 45) { // for neg sign (45)->>94->>46
          let = 46 * 81; let += 1; Lsize = 52;
        } else {
          //Lsize = 24; //for space (6 pixels)
        }

      }
    }
    for (int k = let; k < let + 80; k++) {
      byte data = pgm_read_byte_near(fontConsole + k);
      if (i >= werd.length() || let < 0) data = 0;
      wireReBuff(30); // Wire.endTransmission(); Wire.beginTransmission(0x3C); Wire.write(0B01000000); bytesOut = 1;
      bytesOut++; limit++; if (limit > 511)break;

      if (!(page & 0x80)) {
        Wirewrite(data);
      } else {
        Wirewrite(~(data));
      }
      w++;
      Lsize--; if (Lsize == 0) break; //so letters can scrunch together
    }
  }
  WireendTransmission();     // stop transmitting
  curse += w / 4;
}




void OLEDwerdsSm(String werd, byte col, byte page, byte L) { //5x7 chars so 6 per, single page
  byte p = page & 0x07; byte limit = col;
  OLED_pointTo(col, 127, p + 4, p + 4);
  wireBegin();
  if (L == 0) L = werd.length();

  for (byte i = 0; i < L; i++) {
    int let = (werd.charAt(i) - 32) * 5; // letter
    for (int k = let; k < let + 6; k++) {
      byte data = pgm_read_byte_near(font5x7 + k);
      //  byte data=EEPROM.read(553+k);
      if (i >= werd.length()) data = 0;
      if (k == let + 5) data = 0; //make space
      //    if (fromKnob && i >= werd.length()) data = 0; // make rest blank
      // Serial.print(data, HEX); Serial.print(" ");
      //    if (bytesOut >= 30) {
      wireReBuff(30); // Wire.endTransmission(); Wire.beginTransmission(0x3C); Wire.write(0B01000000); bytesOut = 1;
      //    }
      bytesOut++; limit++; if (limit > 127)break;
      if (!(page & 0x80)) {
        Wirewrite(data);
      } else {
        Wirewrite(~(data));
      }
    }
  }
  WireendTransmission();     // stop transmitting
}



void standBy() { //display config # and user name when standby called every 10mS
  if (menuLev != 0)return;
  if (timeShow == 0) {
    timeShow = 5;
    OLED_UD(512, 0, 127, 4, 7); //full screen
    String t = "T:"; if (hours < 10) t += " ";
    t += String(hours) + ":";
    if (mins < 10)t += "0";
    t += String(mins);
    OLEDwerds(t, 0, 0, 0);
    stbyStep = -200;
  } else {
    stbyStep++;
    if (stbyStep == 100) {
      OLEDwerds("USER:", 0, 0, 0);
      String un = String(user + 1);
      if (user < 9) {
        un = "0" + un;
      }
      OLEDwerds(un, 80, 0, 0);
      timeShow--;
    }
    if (stbyStep > 399 && stbyStep < 1040) {
      if (stbyStep == 400) {
        OLED_UD(512, 0, 127, 4, 7); //full screen
        //Serial.println(name);
      }
      nameStep++;
      if (nameStep == 25) {
        nameStep = 0;
        String ars = name; ars = "      " + ars; ars += afterSpaces; //
        OLEDwerds(ars.substring(nameScroll, nameScroll + 9), 0, 0, 0);
        nameScroll++;
        if (nameScroll > 22) {
          nameScroll = 0;  nameStep = 0; stbyStep = 1025;
        }
      }
    }
    if (stbyStep == 1040) OLEDwerds("INCLOCK", 0, 0, 0);
    if (stbyStep == 1140)  OLED_UD(512, 0, 127, 4, 7); //full screen
    if (stbyStep == 1150) {
      String t = "ICK:";
      if ((clk1[0] & 0x01) || (clk1[1] & 0x01) || (clk1[2] & 0x01)) t += "1";
      if ((clk2[0] & 0x01) || (clk2[1] & 0x01) || (clk2[2] & 0x01)) t += "2";
      if ((clk3[0] & 0x01) || (clk3[1] & 0x01) || (clk3[2] & 0x01)) t += "3";
      OLEDwerds(t, 0, 0, 0);
    }
    if (stbyStep == 1300) {
      stbyStep = 0; OLED_UD(512, 0, 127, 4, 7); //full screen
    }
  }
}


void arrow(byte c) { //tiny arrow to select menu items
  OLED_UD(16, 0, 3, 4, 7);//clearColumn
  OLED_pointTo(0, 3, c + 4, c + 4 );
  wireBegin();  a[0] = 0xff; a[1] = 0x7e; a[2] = 0x3c; a[3] = 0x18;
  wireReBuff(20);
  for (byte i = 0; i < 4; i++) {
    wireWrite(a[i]);
  }
  WireendTransmission();     // stop transmitting
}

void splash() {
  OLED_UD(512, 0, 127, 4, 7);//clearColumn
  OLED_pointTo(0, 127, 4, 7 );
  for (byte k = 0; k < 20; k++) {
    OLED_pointTo(0, 127, 4, 7 );
    wireBegin(); wireReBuff(20);
    byte w = 1; byte h = random(255); byte ww = 1;
    for ( int i = 0; i < 512; i++) {
      wireWrite(ww); wireReBuff(30); bytesOut++;
      ww = w << (h / 24); h += random(h + 2 - k);
    }
    WireendTransmission();     // stop transmitting
    for ( int i = 0; i < 30; i++) {
      OLEDwerdsSm("o", random(90) + 30, random(4), 1); delay(2);
    }
    delay(40);
  }
  for ( int i = 0; i < 512; i++) {
    OLEDwerdsSm(" ", random(128), random(4), 1); delay(2);
  }
}
